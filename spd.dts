/dts-v1/;
/plugin/;

/ {
    fragment@0 {
        target-path = "/";
        __overlay__ {
            fakedevice {
                compatible = "encoder-gpio";
		        userbutton-gpios = <&gpio 21 0>; 
            };
        };
    };

};
